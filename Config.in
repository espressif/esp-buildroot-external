## Config.in
```kconfig
source "$BR2_EXTERNAL_ESP_LINUX_BSP_PATH/package/esp-linux-bsp/Config.in"
source "$BR2_EXTERNAL_ESP_LINUX_BSP_PATH/package/esp-linux-hello-world/Config.in"
source "$BR2_EXTERNAL_ESP_LINUX_BSP_PATH/package/esp-system-dashboard/Config.in"
```

## configs/espressif_esp32s31_function_core_board_nor_defconfig
```kconfig
BR2_riscv=y
BR2_riscv_custom=y
BR2_RISCV_ISA_RVM=y
BR2_RISCV_ISA_RVA=y
BR2_RISCV_ISA_RVC=y
BR2_RISCV_32=y
BR2_TOOLCHAIN_EXTERNAL=y
BR2_TOOLCHAIN_EXTERNAL_DOWNLOAD=y
BR2_TOOLCHAIN_EXTERNAL_URL="https://dl.espressif.com/dl/toolchains/preview/riscv64/14.1.1_20260922/riscv64-esp-linux-musl-14.1.1_20260922-$(HOSTARCH)-linux-gnu.tar.xz"
BR2_TOOLCHAIN_EXTERNAL_CUSTOM_PREFIX="riscv64-esp-linux-musl"
BR2_TOOLCHAIN_EXTERNAL_HEADERS_6_6=y
BR2_TOOLCHAIN_EXTERNAL_CUSTOM_MUSL=y
BR2_TOOLCHAIN_EXTERNAL_CXX=y
# BR2_TARGET_GENERIC_GETTY is not set
BR2_ROOTFS_OVERLAY="$(BR2_EXTERNAL_ESP_LINUX_BSP_PATH)/board/espressif/esp32s31/rootfs_overlay"
BR2_ROOTFS_POST_FAKEROOT_SCRIPT="$(BR2_EXTERNAL_ESP_LINUX_BSP_PATH)/board/espressif/esp32s31/rootfs-cramfs.sh"
BR2_ROOTFS_POST_IMAGE_SCRIPT="$(BR2_EXTERNAL_ESP_LINUX_BSP_PATH)/board/espressif/esp32s31/post-image.sh"
BR2_ROOTFS_POST_IMAGE_SCRIPT_ARGS="nor"
BR2_LINUX_KERNEL=y
BR2_LINUX_KERNEL_CUSTOM_GIT=y
BR2_LINUX_KERNEL_CUSTOM_REPO_URL="https://github.com/espressif/linux.git"
BR2_LINUX_KERNEL_CUSTOM_REPO_VERSION="integration/v6.18-esp32s31"
BR2_LINUX_KERNEL_DEFCONFIG="esp32s31_minimal"
BR2_LINUX_KERNEL_IMAGE_TARGET_CUSTOM=y
BR2_LINUX_KERNEL_IMAGE_TARGET_NAME="xipImage"
BR2_LINUX_KERNEL_DTS_SUPPORT=y
BR2_LINUX_KERNEL_INTREE_DTS_NAME="espressif/esp32s31"
BR2_TARGET_ROOTFS_CPIO=y
BR2_TARGET_ROOTFS_CPIO_GZIP=y
BR2_TARGET_OPENSBI=y
BR2_TARGET_OPENSBI_CUSTOM_GIT=y
BR2_TARGET_OPENSBI_CUSTOM_REPO_URL="https://github.com/espressif/opensbi.git"
BR2_TARGET_OPENSBI_CUSTOM_REPO_VERSION="integration/v1.6-esp32s31"
BR2_TARGET_OPENSBI_PLAT="generic"
BR2_TARGET_OPENSBI_ADDITIONAL_VARIABLES="PLATFORM_DEFCONFIG=esp32s31_defconfig PLATFORM_RISCV_XLEN=32"
BR2_TARGET_UBOOT=y
BR2_TARGET_UBOOT_BUILD_SYSTEM_KCONFIG=y
BR2_TARGET_UBOOT_CUSTOM_GIT=y
BR2_TARGET_UBOOT_CUSTOM_REPO_URL="https://github.com/espressif/u-boot.git"
BR2_TARGET_UBOOT_CUSTOM_REPO_VERSION="integration/v2024.07-esp32s31"
BR2_TARGET_UBOOT_BOARD_DEFCONFIG="espressif_esp32s31"
BR2_TARGET_UBOOT_NEEDS_OPENSBI=y
BR2_TARGET_UBOOT_USE_BINMAN=y
BR2_TARGET_UBOOT_FORMAT_DTB=y
BR2_TARGET_UBOOT_FORMAT_ITB=y
BR2_TARGET_UBOOT_SPL=y
BR2_TARGET_UBOOT_SPL_NAME="spl/u-boot-spl-dtb.bin"
BR2_PACKAGE_HOST_CRAMFS=y
BR2_PACKAGE_HOST_ESP_LINUX_BSP=y
```

## package/esp-linux-blink/Config.in
```kconfig
config BR2_PACKAGE_ESP_LINUX_BLINK
	bool "ESP Linux GPIO blink"
	depends on BR2_TOOLCHAIN_HEADERS_AT_LEAST_4_8
	select BR2_PACKAGE_LIBGPIOD
	help
	  Minimal application that blinks an LED through the Linux GPIO
	  character-device interface and libgpiod.

	  https://github.com/espressif/esp-linux-examples
```

## package/esp-linux-hello-world/Config.in
```kconfig
config BR2_PACKAGE_ESP_LINUX_HELLO_WORLD
	bool "ESP Linux hello-world"
	help
	  Minimal application that prints "Hello, ESP Linux!" and exits.

	  https://github.com/espressif/esp-linux-examples
```

## package/esp-system-dashboard/Config.in
```kconfig
config BR2_PACKAGE_ESP_SYSTEM_DASHBOARD
	bool "ESP system dashboard"
	select BR2_PACKAGE_LIBMICROHTTPD
	help
	  Web dashboard that reports system, runtime, and network status.

	  https://github.com/espressif/esp-linux-examples
```
